## ergofunctor/kowalskiexe-zmk-config/boards/shields/ergofunctor/Kconfig.shield
```kconfig
config SHIELD_ERGOFUNCTOR_LEFT
    def_bool $(shields_list_contains,ergofunctor_left)

config SHIELD_ERGOFUNCTOR_RIGHT
    def_bool $(shields_list_contains,ergofunctor_right)
```
