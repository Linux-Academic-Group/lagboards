## oreganokb/zmk/oreganokb-zmk-config/config/boards/shields/oregano/Kconfig.defconfig
```kconfig
if SHIELD_OREGANO_LEFT

config ZMK_KEYBOARD_NAME
    default "Oregano"

config ZMK_SPLIT_ROLE_CENTRAL
    default y

endif # SHIELD_OREGANO_LEFT

if SHIELD_OREGANO_LEFT || SHIELD_OREGANO_RIGHT

config ZMK_SPLIT
    default y

endif # SHIELD_OREGANO_LEFT || SHIELD_OREGANO_RIGHT
```

## oreganokb/zmk/oreganokb-zmk-config/config/boards/shields/oregano/Kconfig.shield
```kconfig
config SHIELD_OREGANO_LEFT
    def_bool $(shields_list_contains,oregano_left)

config SHIELD_OREGANO_RIGHT
    def_bool $(shields_list_contains,oregano_right)
```
